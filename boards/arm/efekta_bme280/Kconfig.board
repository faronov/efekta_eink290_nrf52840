## boards/arm/efekta_bme280/Kconfig.board
```kconfig
# Copyright (c) 2021 Nordic Semiconductor ASA
# SPDX-License-Identifier: Apache-2.0

config BOARD_EFEKTA_BME280
	bool "efekta_bme280"
	depends on SOC_NRF52840_QIAA
```

## boards/arm/efekta_bme280/Kconfig.defconfig
```kconfig
# Copyright (c) 2021 Nordic Semiconductor ASA
# SPDX-License-Identifier: Apache-2.0

if BOARD_EFEKTA_BME280

config BOARD
	default "efekta_bme280"

config BT_CTLR
   default BT

endif
```

## boards/arm/efekta_bme280/efekta_bme280_defconfig
```kconfig
# Copyright (c) 2021 Nordic Semiconductor ASA
# SPDX-License-Identifier: Apache-2.0

CONFIG_SOC_SERIES_NRF52X=y
CONFIG_SOC_NRF52840_QIAA=y
CONFIG_BOARD_EFEKTA_BME280=y

# Enable MPU
CONFIG_ARM_MPU=y

# Enable hardware stack protection
CONFIG_HW_STACK_PROTECTION=y

CONFIG_ADC=y

CONFIG_I2C=y

CONFIG_NFCT_PINS_AS_GPIOS=y
CONFIG_GPIO_AS_PINRESET=y
```

## boards/arm/efekta_eink290_nrf52840/Kconfig.board
```kconfig
# Copyright (c) 2021 Nordic Semiconductor ASA
# SPDX-License-Identifier: Apache-2.0

config BOARD_EFEKTA_EINK290_NRF52840
	bool "EFEKTA EINK290 nRF52840"
	depends on SOC_NRF52840_QIAA
```

## boards/arm/efekta_eink290_nrf52840/Kconfig.defconfig
```kconfig
# Copyright (c) 2021 Nordic Semiconductor ASA
# SPDX-License-Identifier: Apache-2.0

if BOARD_EFEKTA_EINK290_NRF52840

config BOARD
	default "efekta_eink290_nrf52840"

config BT_CTLR
   default BT

endif
```

## boards/arm/efekta_eink290_nrf52840/efekta_eink290_nrf52840_defconfig
```kconfig
# Copyright (c) 2021 Nordic Semiconductor ASA
# SPDX-License-Identifier: Apache-2.0

CONFIG_SOC_SERIES_NRF52X=y
CONFIG_SOC_NRF52840_QIAA=y
CONFIG_BOARD_EFEKTA_EINK290_NRF52840=y

# Enable MPU
CONFIG_ARM_MPU=y

# Enable hardware stack protection
CONFIG_HW_STACK_PROTECTION=y

CONFIG_I2C=y
CONFIG_UART_INTERRUPT_DRIVEN=y
CONFIG_HEAP_MEM_POOL_SIZE=2048
CONFIG_SERIAL=y
CONFIG_NCS_SAMPLES_DEFAULTS=y
CONFIG_SYSTEM_WORKQUEUE_STACK_SIZE=2048
CONFIG_ZIGBEE=y
CONFIG_ZIGBEE_APP_UTILS=y
CONFIG_ZIGBEE_CHANNEL_SELECTION_MODE_MULTI=y
CONFIG_DK_LIBRARY=y
# CONFIG_ENTROPY_CC3XX is not set
CONFIG_SOC_SERIES_NRF52X=y
CONFIG_SOC_NRF52840_QIAA=y
CONFIG_CONSOLE=y
CONFIG_UART_CONSOLE=y
CONFIG_ENTROPY_NRF5_THR_THRESHOLD=4
CONFIG_ENTROPY_NRF5_ISR_THRESHOLD=12
CONFIG_BME280=y
CONFIG_BME280_MODE_FORCED=y
CONFIG_BME280_TEMP_OVER_8X=y
CONFIG_BME280_STANDBY_500MS=y
CONFIG_BME280_FILTER_OFF=y
CONFIG_MAX44009=y
CONFIG_CRYPTO=y
CONFIG_CRYPTO_INIT_PRIORITY=80
CONFIG_CRYPTO_NRF_ECB=y
CONFIG_DISPLAY=y
```

## modules/subsys/Kconfig
```kconfig
comment "Subsystems"

rsource "bme280/Kconfig"
rsource "max44009/Kconfig"
rsource "zigbee_device/Kconfig"
```
